## src/extra/configs/mxsystem_defconfig
```kconfig
BR2_arm=y
BR2_cortex_a7=y
BR2_ARM_FPU_NEON=y
BR2_KERNEL_MIRROR="https://www.kernel.org/pub"
BR2_GNU_MIRROR="http://ftp.gnu.org/pub/gnu"
BR2_GLOBAL_PATCH_DIR="$(BR2_EXTERNAL_EXTRAS_PATH)/board/mxsystem/patches"
# BR2_COMPILER_PARANOID_UNSAFE_PATH is not set
BR2_TOOLCHAIN_EXTERNAL=y
BR2_TOOLCHAIN_EXTERNAL_CUSTOM=y
BR2_TOOLCHAIN_EXTERNAL_PATH="$(BR2_EXTERNAL_EXTRAS_PATH)/../toolchain"
BR2_TOOLCHAIN_EXTERNAL_CUSTOM_PREFIX="arm-linux-gnueabihf"
BR2_TOOLCHAIN_EXTERNAL_GCC_5=y
BR2_TOOLCHAIN_EXTERNAL_HEADERS_4_0=y
BR2_TOOLCHAIN_EXTERNAL_CUSTOM_GLIBC=y
BR2_TOOLCHAIN_EXTERNAL_CXX=y
BR2_TOOLCHAIN_EXTERNAL_GDB_SERVER_COPY=y
BR2_TARGET_OPTIMIZATION="-marm -mfpu=neon-vfpv4 -mtune=cortex-a7"
BR2_TARGET_GENERIC_HOSTNAME="somul"
BR2_TARGET_GENERIC_ISSUE="SoM UltraLite System Console"
BR2_TARGET_GENERIC_PASSWD_SHA512=y
BR2_SYSTEM_DHCP="eth0"
# BR2_ENABLE_LOCALE_PURGE is not set
BR2_TARGET_TZ_INFO=y
BR2_TARGET_LOCALTIME="Europe/Prague"
BR2_ROOTFS_OVERLAY="$(BR2_EXTERNAL_EXTRAS_PATH)/board/mxsystem/overlay"
BR2_ROOTFS_POST_BUILD_SCRIPT="$(BR2_EXTERNAL_EXTRAS_PATH)/board/common/post-build.sh"
BR2_LINUX_KERNEL=y
BR2_LINUX_KERNEL_CUSTOM_GIT=y
BR2_LINUX_KERNEL_CUSTOM_REPO_URL="git://git.freescale.com/imx/linux-imx.git"
BR2_LINUX_KERNEL_CUSTOM_REPO_VERSION="rel_imx_4.1.15_2.1.0_ga"
BR2_LINUX_KERNEL_USE_CUSTOM_CONFIG=y
BR2_LINUX_KERNEL_CUSTOM_CONFIG_FILE="$(BR2_EXTERNAL_EXTRAS_PATH)/board/mxsystem/kernel.cfg"
BR2_LINUX_KERNEL_DTS_SUPPORT=y
BR2_LINUX_KERNEL_INTREE_DTS_NAME="imx6ul-somul-v2 imx6ul-somul-v2-spi imx6ul-somul-v2-ov2710 imx6ul-somul-v2-ov5640"
BR2_PACKAGE_BUSYBOX_CONFIG_FRAGMENT_FILES="$(BR2_EXTERNAL_EXTRAS_PATH)/board/mxsystem/busybox.cfg"
BR2_PACKAGE_ALSA_UTILS=y
BR2_PACKAGE_ALSA_UTILS_AMIXER=y
BR2_PACKAGE_ALSA_UTILS_APLAY=y
BR2_PACKAGE_ALSA_UTILS_SPEAKER_TEST=y
BR2_PACKAGE_FLAC=y
BR2_PACKAGE_BZIP2=y
BR2_PACKAGE_XZ=y
BR2_PACKAGE_DHRYSTONE=y
BR2_PACKAGE_IOZONE=y
BR2_PACKAGE_LMBENCH=y
BR2_PACKAGE_MEMSTAT=y
BR2_PACKAGE_NETPERF=y
BR2_PACKAGE_RAMSPEED=y
BR2_PACKAGE_STRESS=y
BR2_PACKAGE_TINYMEMBENCH=y
BR2_PACKAGE_WHETSTONE=y
BR2_PACKAGE_BINUTILS=y
BR2_PACKAGE_MAKE=y
BR2_PACKAGE_DOSFSTOOLS=y
BR2_PACKAGE_DOSFSTOOLS_MKFS_FAT=y
BR2_PACKAGE_MTD=y
# BR2_PACKAGE_MTD_FLASHCP is not set
# BR2_PACKAGE_MTD_FLASH_LOCK is not set
# BR2_PACKAGE_MTD_FLASH_UNLOCK is not set
# BR2_PACKAGE_MTD_MTD_DEBUG is not set
# BR2_PACKAGE_MTD_NANDTEST is not set
BR2_PACKAGE_SL=y
BR2_PACKAGE_QT5=y
BR2_PACKAGE_QT5BASE_MYSQL=y
BR2_PACKAGE_QT5BASE_ICU=y
BR2_PACKAGE_QT5SERIALPORT=y
BR2_PACKAGE_QT5WEBSOCKETS=y
BR2_PACKAGE_QT5XMLPATTERNS=y
BR2_PACKAGE_EVTEST=y
BR2_PACKAGE_FREESCALE_IMX=y
BR2_PACKAGE_FREESCALE_IMX_PLATFORM_IMX6Q=y
BR2_PACKAGE_IMX_KOBS=y
BR2_PACKAGE_HWDATA=y
BR2_PACKAGE_LSHW=y
BR2_PACKAGE_MEMTESTER=y
BR2_PACKAGE_MINICOM=y
BR2_PACKAGE_TRIGGERHAPPY=y
BR2_PACKAGE_NODEJS=y
BR2_PACKAGE_NODEJS_NPM=y
BR2_PACKAGE_PYTHON=y
BR2_PACKAGE_PYTHON_READLINE=y
BR2_PACKAGE_PYTHON_SSL=y
BR2_PACKAGE_PYTHON_PYEXPAT=y
BR2_PACKAGE_PYTHON_ZLIB=y
BR2_PACKAGE_PYTHON_HASHLIB=y
BR2_PACKAGE_OPUS=y
BR2_PACKAGE_CA_CERTIFICATES=y
BR2_PACKAGE_LIBGCRYPT=y
BR2_PACKAGE_OPENSSL_BIN=y
BR2_PACKAGE_OPENSSL_ENGINES=y
BR2_PACKAGE_MARIADB=y
BR2_PACKAGE_MARIADB_SERVER=y
BR2_PACKAGE_JPEG=y
BR2_PACKAGE_LIBPNG=y
BR2_PACKAGE_LIBTHEORA=y
BR2_PACKAGE_CZMQ=y
BR2_PACKAGE_CURL=y
BR2_PACKAGE_LIBPCAP=y
BR2_PACKAGE_LIBCGROUP=y
BR2_PACKAGE_LIBCGROUP_TOOLS=y
BR2_PACKAGE_LIBGLIB2=y
BR2_PACKAGE_AESPIPE=y
BR2_PACKAGE_BC=y
BR2_PACKAGE_CAN_UTILS=y
BR2_PACKAGE_DROPBEAR=y
BR2_PACKAGE_ETHTOOL=y
BR2_PACKAGE_GESFTPSERVER=y
BR2_PACKAGE_HOSTAPD=y
BR2_PACKAGE_IPROUTE2=y
BR2_PACKAGE_IW=y
BR2_PACKAGE_SER2NET=y
BR2_PACKAGE_WIRELESS_REGDB=y
BR2_PACKAGE_WPA_SUPPLICANT=y
BR2_PACKAGE_WPA_SUPPLICANT_AP_SUPPORT=y
BR2_PACKAGE_WPA_SUPPLICANT_AUTOSCAN=y
BR2_PACKAGE_WPA_SUPPLICANT_EAP=y
BR2_PACKAGE_WPA_SUPPLICANT_CLI=y
BR2_PACKAGE_WPA_SUPPLICANT_PASSPHRASE=y
BR2_PACKAGE_FTOP=y
BR2_PACKAGE_HTOP=y
BR2_TARGET_UBOOT=y
BR2_TARGET_UBOOT_BUILD_SYSTEM_KCONFIG=y
BR2_TARGET_UBOOT_CUSTOM_GIT=y
BR2_TARGET_UBOOT_CUSTOM_REPO_URL="git://git.freescale.com/imx/uboot-imx.git"
BR2_TARGET_UBOOT_CUSTOM_REPO_VERSION="imx_v2016.03_4.1.15_2.0.0_ga"
BR2_TARGET_UBOOT_BOARD_DEFCONFIG="mx6ul_14x14_somul"
# BR2_TARGET_UBOOT_FORMAT_BIN is not set
BR2_TARGET_UBOOT_FORMAT_IMX=y
BR2_PACKAGE_DOTNET_RUNTIME=y
```

## src/extra/package/dotnet-runtime/Config.in
```kconfig
config BR2_PACKAGE_DOTNET_RUNTIME
	bool "dotnet-runtime"
  select BR2_PACKAGE_GETTEXT
  select BR2_PACKAGE_ICU
  select BR2_PACKAGE_LIBCURL
  select BR2_PACKAGE_LIBUNWIND
  select BR2_PACKAGE_LTTNG_UST
  select BR2_PACKAGE_OPENSSL
	depends on BR2_TOOLCHAIN_HAS_THREADS
  depends on BR2_arm
	help
	  dot net core runtime

comment "dotnet-runtime needs a toolchain w/ threads"
	depends on !BR2_TOOLCHAIN_HAS_THREADS
```

## src/extra/package/libuwebsockets/Config.in
```kconfig
config BR2_PACKAGE_LIBUWEBSOCKETS
	bool "libuwebsockets"
  select BR2_PACKAGE_LIBUV
  select BR2_PACKAGE_OPENSSL
  select BR2_PACKAGE_ZLIB
	depends on BR2_TOOLCHAIN_HAS_THREADS
	help
	  Fast and lightweight library for WebSockets

if BR2_PACKAGE_LIBUWEBSOCKETS

config BR2_PACKAGE_LIBUWEBSOCKETS_EXAMPLES
	bool "Install examples"
	help
	  Install examples to target.

endif

comment "libuwebsockets needs a toolchain w/ threads"
	depends on !BR2_TOOLCHAIN_HAS_THREADS
```

## src/extra/package/mDNSResponder/Config.in
```kconfig
config BR2_PACKAGE_MDNSRESPONDER
	bool "mDNSResponder"
	depends on BR2_TOOLCHAIN_HAS_THREADS
	help
	  Apple mDNS responder - server for device discovery

comment "mDNSResponder needs a toolchain w/ threads"
	depends on !BR2_TOOLCHAIN_HAS_THREADS
```

## src/extra/package/mdnsd/Config.in
```kconfig
config BR2_PACKAGE_MDNSD
	bool "mdnsd"
	depends on BR2_TOOLCHAIN_HAS_THREADS
	help
	  mDNS responder - server for device discovery

comment "mdnsd needs a toolchain w/ threads"
	depends on !BR2_TOOLCHAIN_HAS_THREADS
```

## src/extra/package/nrf24/Config.in
```kconfig
config BR2_PACKAGE_NRF24
	bool "nrf24"
	depends on BR2_LINUX_KERNEL && BR2_arm
	select BR2_LINUX_NEEDS_MODULES
	help
	  Kernel module for Nordic Semi nRF24L01+

comment "nrf24 needs a Linux kernel to be built"
	depends on BR2_arm
	depends on !BR2_LINUX_KERNEL
```

## src/extra/package/rfm73/Config.in
```kconfig
config BR2_PACKAGE_RFM73
	bool "rfm73"
	depends on BR2_LINUX_KERNEL
	select BR2_LINUX_NEEDS_MODULES
	help
	  rfm73 netdev driver

comment "rfm73 needs a Linux kernel to be built"
	depends on !BR2_LINUX_KERNEL
  
```
